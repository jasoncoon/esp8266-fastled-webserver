#include "common.h"

#if HAS_COORDINATE_MAP // IS_FIBONACCI implies HAS_COORDINATE_MAP

// Each Fibonacci board must define the following arrays:
//
// physicalToFibonacci[] === given physical pixel number, get it's order if sorted by distance from center (radius, aka the vogel spiral order)
// fibonacciToPhysical[] === given index to pixel in radial order (vogel spiral order), get physical pixel index
// angles[]              === angle, using units where 256 units == 360 degrees
// coordsX[] / coordsY[] === uint8_t coordinates for transformed spiral
//
// All boards appear to use the vogel model, with offset to first point == 0.
// [[ This can be confirmed by first element of angles[] === 0,
//    i.e., the first point is the center of the spiral at origin (x=0, y=0)
// ]]
//
// 1. Using radial coordinates, the Nth pixel's position is defined as:
// ```
// r = sqrt(n)
// theta = n * GOLDEN_ANGLE
// ```
//
// 2. Calculate all coordinates, giving Vogel's model centered at the origin
//
// 3. Store theta in `angles[]` (after converting to units where 256 units == 360 degrees)
//
// 4. Convert the radial coordinates to cartesian (x/y) coordinates
//
// 5. Transform the coordinates, such as via following pseudo-code:
//
// ```C++
// // first, translate from origin == center so left side and bottom aligned with X/Y axis
// double shiftX := min(originalCoordinatesX[]);
// double shiftY := min(originalCoordinatesY[]);
// double translatedX[] <== originalCoordinatesX[] - shiftX; // shifts right to align left side with X=0
// double translatedY[] = originalCoordinatesY[] - shiftY; // shifts upward to align bottom with Y=0
// // next, scale so that values lie entirely within the range [ 0.0 ... 256.0 ]
// double maxXY = max(max(translatedX[]), max(translatedY[]);
// double scaleFactor = 256.0 / maxXY;
// double scaledX[] = translatedX[] * scaleFactor;
// double scaledY[] = translatedY[] * scaleFactor;
// // finally, convert to integer values in the range [ 0 ... 255 ]
// uint8_t coordsX[] = (uint8_t)(scaledX[] - 0.5); // subtract 0.5 to avoid bias
// uint8_t coordsY[] = (uint8_t)(scaledY[] - 0.5); // subtract 0.5 to avoid bias
// ```
//
// There appears to have been a conscious decision to store the X/Y
// values as 8-bit values.  Perhaps this was to allow for faster
// (8-bit) math operations on lower-power MCUs?
//
// Of course, the supported boards are ESP8266 or ESP32 (or SAMD21E),
// each of which are 32-bit native processors.  If this was on AVR,
// the continued use of 8-bit algorithms would be more critical.
//

#if defined(PRODUCT_FIBONACCI1024)
  const uint16_t physicalToFibonacci[NUM_PIXELS]   { 0, 55, 110, 165, 220, 275, 330, 385, 440, 495, 550, 605, 660,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 914, 969 };
  const uint16_t fibonacciToPhysical[NUM_PIXELS]   { 0, 391, 800, 149, 558, 931, 316, 689, 74, 447, 856, 205, 596,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 224, 633 };
  const uint8_t  coordsX[NUM_PIXELS]               { 130, 157, 169, 178, 185, 192, 197, 201, 204, 207, 209, 211, 212,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 217, 215 };
  const uint8_t  coordsY[NUM_PIXELS]               { 127, 125, 123, 119, 115, 110, 105, 99, 93, 87, 81, 74, 68,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 46, 39 };
  const uint8_t  angles[NUM_PIXELS]                { 255, 2, 4, 6, 8, 10, 12, 14, 16, 19, 21, 23, 25,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 30, 32 };
  const uint8_t  radius[NUM_PIXELS]                { 0, 55, 80, 99, 115, 130, 142, 154, 165, 176, 185, 195, 204,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 241, 248 };
  const uint8_t  (&radiusProxy)[NUM_PIXELS] = radius;
#elif defined(PRODUCT_FIBONACCI512)
  const uint16_t physicalToFibonacci[NUM_PIXELS] { 510, 476, 442, 408, 374, 340, 306, 272, 238, 204, 170, 136, 102,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 463, 497 };
  const uint16_t fibonacciToPhysical[NUM_PIXELS] { 15, 316, 135, 437, 255, 46, 376, 166, 496, 286, 105, 407, 225,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 0, 331 };
  const uint8_t  coordsX[NUM_PIXELS]             { 170, 178, 185, 191, 196, 199, 202, 202, 202, 200, 196, 191, 184,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 200, 194 };
  const uint8_t  coordsY[NUM_PIXELS]             { 6, 14, 22, 31, 41, 50, 60, 70, 80, 89, 98, 106, 114,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 29, 19 };
  const uint8_t  angles[NUM_PIXELS]              { 205, 208, 211, 215, 218, 221, 225, 228, 231, 235, 238, 242, 245,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 217, 213 };
  const uint8_t  radius[NUM_PIXELS]              { 255, 238, 221, 204, 187, 170, 153, 136, 119, 102, 85, 68, 51,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 231, 248 };
  const uint8_t (&radiusProxy)[NUM_PIXELS] = radius;
#elif defined(PRODUCT_FIBONACCI256)
  const uint8_t  physicalToFibonacci[NUM_PIXELS] { 0, 13, 26, 39, 52, 65, 78, 91, 104, 117, 130, 143, 156,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 242, 255 };
  const uint8_t  fibonacciToPhysical[NUM_PIXELS] { 0, 157, 78, 235, 118, 39, 196, 79, 236, 156, 40, 197, 117,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 98, 255 };
  const uint8_t  coordsX[NUM_PIXELS]             { 133, 156, 165, 168, 165, 158, 147, 132, 114, 95, 76, 57, 41,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 12, 23 };
  const uint8_t  coordsY[NUM_PIXELS]             { 126, 120, 109, 96, 82, 69, 57, 49, 45, 45, 50, 59, 74,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 176, 202 };
  const uint8_t  angles[NUM_PIXELS]              { 0, 247, 238, 229, 220, 211, 203, 194, 185, 176, 167, 159, 150,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 111, 103 };
  const uint8_t (&radiusProxy)[NUM_PIXELS] = physicalToFibonacci;
#elif defined(PRODUCT_FIBONACCI128)
  const uint8_t  physicalToFibonacci[NUM_PIXELS] { 0, 13, 26, 39, 52, 65, 78, 91, 104, 117, 122, 109, 96,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 112, 125 };
  const uint8_t  fibonacciToPhysical[NUM_PIXELS] { 0, 79, 39, 117, 59, 19, 98, 40, 118, 78, 20, 99, 58,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 69, 29 };
  const uint8_t  coordsX[NUM_PIXELS]             { 137, 170, 182, 186, 182, 172, 156, 135, 110, 83, 26, 49, 74,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 152, 125 };
  const uint8_t  coordsY[NUM_PIXELS]             { 130, 121, 105, 86, 66, 47, 31, 19, 13, 13, 55, 39, 30,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 9, 0 };
  const uint8_t  angles[NUM_PIXELS]              { 0, 247, 239, 230, 221, 212, 203, 194, 186, 177, 154, 163, 171,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 200, 191 };
  const uint8_t  radius[NUM_PIXELS]              { 0, 26, 52, 78, 104, 131, 157, 183, 209, 235, 245, 219, 193,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 225, 251 };
  const uint8_t (&radiusProxy)[NUM_PIXELS] = radius;
#elif defined(PRODUCT_FIBONACCI64_FULL) || defined(PRODUCT_FIBONACCI64_MINI) || defined(PRODUCT_FIBONACCI64_MICRO) || defined(PRODUCT_FIBONACCI64_NANO)
  const uint8_t  physicalToFibonacci[NUM_PIXELS] { 0, 13, 26, 39, 52, 57, 44, 31, 18, 5, 10, 23, 36,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 47, 60 };
  const uint8_t  fibonacciToPhysical[NUM_PIXELS] { 0, 39, 19, 58, 29, 9, 48, 20, 59, 38, 10, 49, 28,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 14, 53 };
  const uint8_t  coordsX[NUM_PIXELS]             { 140, 189, 208, 214, 208, 146, 168, 180, 180, 162, 152, 146, 129,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 240, 244 };
  const uint8_t  coordsY[NUM_PIXELS]             { 128, 114, 91, 63, 34, 0, 21, 48, 76, 106, 78, 47, 25,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 93, 63 };
  const uint8_t  angles[NUM_PIXELS]              { 0, 249, 241, 232, 223, 200, 208, 217, 226, 235, 212, 203, 194,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 246, 237 };
  const uint8_t  radius[NUM_PIXELS]              { 0, 53, 105, 158, 210, 231, 178, 125, 73, 20, 40, 93, 146,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 190, 243 };
  const uint8_t (&radiusProxy)[NUM_PIXELS] = radius;
#elif defined(PRODUCT_FIBONACCI32)
  const uint8_t  physicalToFibonacci[NUM_PIXELS] { 0, 13, 26, 31, 18, 5, 10, 23, 28, 15, 2, 7, 20, 33, 25, 12, 4, 17, 30, 22, 9, 1, 14, 27, 32, 19, 6, 11, 24, 29, 16, 3, 8, 21 };
  const uint8_t  fibonacciToPhysical[NUM_PIXELS] { 0, 21, 10, 31, 16, 5, 26, 11, 32, 20, 6, 27, 15, 1, 22, 9, 30, 17, 4, 25, 12, 33, 19, 7, 28, 14, 2, 23, 8, 29, 18, 3, 24, 13 };
  const uint8_t  coordsX[NUM_PIXELS]             { 152, 224, 252, 210, 211, 184, 169, 161, 89, 121, 138, 102, 61, 19, 13, 57, 82, 29, 0, 36, 63, 111, 79, 83, 158, 129, 118, 160, 196, 255, 212, 163, 203, 250 };
  const uint8_t  coordsY[NUM_PIXELS]             { 120, 101, 69, 7, 48, 90, 50, 7, 0, 27, 83, 62, 37, 35, 84, 78, 112, 125, 154, 185, 149, 140, 195, 236, 255, 226, 179, 198, 223, 181, 183, 156, 144, 135 };
  const uint8_t  angles[NUM_PIXELS]              { 255, 246, 237, 214, 223, 232, 208, 199, 176, 185, 193, 170, 161, 152, 138, 147, 132, 123, 114, 100, 108, 94, 85, 76, 53, 62, 70, 47, 38, 15, 23, 32, 9, 0 };
  const uint8_t  radius[NUM_PIXELS]              { 0, 100, 201, 240, 139, 39, 77, 178, 216, 116, 15, 54, 155, 255, 193, 93, 31, 131, 232, 170, 70, 8, 108, 209, 247, 147, 46, 85, 185, 224, 124, 23, 62, 162 };
  const uint8_t (&radiusProxy)[NUM_PIXELS] = radius;
#elif defined(PRODUCT_KRAKEN64)
  const uint8_t  coordsX[NUM_PIXELS]             { 151, 188, 199, 199, 171, 147, 131, 119, 124, 179, 200, 217, 237,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 7, 8 };
  const uint8_t  coordsY[NUM_PIXELS]             { 190, 204, 225, 252, 255, 236, 216, 191, 166, 147, 154, 170, 173,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 197, 215 };
  const uint8_t  angles[NUM_PIXELS]              { 0, 249, 241, 232, 223, 200, 208, 217, 226, 235, 212, 203, 194,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 246, 237 };
  const uint8_t  body[NUM_PIXELS]                { 0, 16, 32, 48, 64, 80, 96, 112, 128, 143, 159, 175, 191,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 239, 255 };
  static_assert(NUM_PIXELS == ARRAY_SIZE2(body), "");
  const uint8_t (&radiusProxy)[NUM_PIXELS] = body;
  // For reference purposes...
  // const uint8_t head[9]      {  0,  1,  2,  3,  4,  5,  6,  7, 8 };
  // const uint8_t tentacle0[8] {  9, 10, 11, 12, 13, 14, 15, 16    };
  // const uint8_t tentacle1[8] { 17, 18, 19, 20, 21, 22, 23, 24    };
  // const uint8_t tentacle2[8] { 25, 26, 27, 28, 29, 30, 31, 32    };
  // const uint8_t tentacle3[8] { 33, 34, 35, 36, 37, 38, 39        };
  // const uint8_t tentacle4[8] { 40, 41, 42, 43, 44, 45, 46, 47    };
  // const uint8_t tentacle5[8] { 48, 49, 50, 51, 52, 53, 54, 55    };
  // const uint8_t tentacle6[8] { 56, 57, 58, 59, 60, 61, 62, 63    };
#elif defined(PRODUCT_CHAMAELEON64)
  const uint8_t  coordsX[NUM_PIXELS]             { 255, 240, 234, 216, 221, 224, 204, 204, 201, 185, 196, 214, 228,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 63, 47 };
  const uint8_t  coordsY[NUM_PIXELS]             { 127, 155, 121, 122, 155, 191, 209, 175, 139, 105, 82, 60, 43,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 63, 57 };
  const uint8_t  angles[NUM_PIXELS]              { 179, 192, 176, 175, 195, 212, 225, 210, 188, 158, 146, 141, 139,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 44, 40 };
  const uint8_t  radii[NUM_PIXELS]               { 206, 185, 168, 135, 150, 185, 178, 137, 107, 83, 122, 172, 213,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 137, 166 };
  static_assert(NUM_PIXELS == ARRAY_SIZE2(radii), "");
  const uint8_t (&radiusProxy)[NUM_PIXELS] = radii;
#elif defined(PRODUCT_1628_RINGS)
  // Yes, this is 1628 pixels ... all driven by one ESP8266
  // 20 concentric rings of pixel goodness!
  const uint8_t  coordsX[NUM_PIXELS] { 134, 128, 121, 128, 140, 139, 134, 128, 121, 116, 115, 116, 121,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 140, 
                                       135, 130, 125, 120, 115, 110, 105, 100, 96, 91, 87, 83,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 174, 
                                       169, 165, 160, 155, 150, 145, 140, 135, 130, 125, 120, 115,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 151, 
                                       146, 141, 136, 131, 126, 121, 116, 111, 106, 101, 96, 92,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 206, 
                                       210, 214, 217, 221, 224, 227, 230, 233, 235, 237, 240, 241,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 255, 255 };
  const uint8_t  coordsY[NUM_PIXELS] { 128, 134, 128, 121, 128, 134, 139, 140, 139, 134, 128, 121, 116,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 190, 
                                       191, 191, 191, 191, 190, 189, 187, 185, 183, 180, 177, 173,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 209, 
                                       211, 212, 214, 215, 216, 216, 217, 217, 216, 216, 215, 214,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 236, 
                                       236, 236, 236, 235, 235, 234, 233, 231, 230, 228, 226, 224,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 35, 
                                       39, 42, 46, 50, 54, 58, 63, 67, 72, 77, 81, 86,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 117, 122 };
  const uint8_t  angles[NUM_PIXELS]  { 0, 64, 128, 191, 0, 21, 43, 64, 85, 106, 128, 149, 170,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 127, 
                                       131, 134, 137, 141, 144, 147, 150, 154, 157, 160, 163, 167,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 114, 
                                       116, 118, 121, 123, 125, 128, 130, 132, 134, 137, 139, 141,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 123, 
                                       125, 127, 128, 130, 132, 134, 136, 138, 140, 142, 144, 145,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 10, 
                                       11, 13, 14, 16, 18, 19, 21, 22, 24, 26, 27, 29,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 252, 253 };
  const uint8_t  radii[NUM_PIXELS]   { 13, 13, 13, 13, 26, 26, 26, 26, 26, 26, 26, 26, 26,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 128, 
                                       128, 128, 128, 128, 128, 128, 128, 128, 128, 128, 128, 128,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 179, 
                                       179, 179, 179, 179, 179, 179, 179, 179, 179, 179, 179, 179,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 217, 
                                       217, 217, 217, 217, 217, 217, 217, 217, 217, 217, 217, 217,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 242, 
                                       242, 242, 242, 242, 242, 242, 242, 242, 242, 242, 242, 242,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 255, 255 };
  const uint8_t (&radiusProxy)[NUM_PIXELS] = radii;

#else
  #error "Unknown / Unsupported product ... no mappings defined"
#endif

#if IS_FIBONACCI
  static_assert(NUM_PIXELS == ARRAY_SIZE2(physicalToFibonacci), "");
  static_assert(NUM_PIXELS == ARRAY_SIZE2(fibonacciToPhysical), "");
#endif

// What is radiusProxy?  It could be the actual radius, or it could be something
// that is used "in place of" the radius during effects processing.
// Use reference to original array; avoids repeating preprocessor checks throughout the code....

static_assert(HAS_COORDINATE_MAP, "");
static_assert(NUM_PIXELS == ARRAY_SIZE2(coordsX), "");
static_assert(NUM_PIXELS == ARRAY_SIZE2(coordsY), "");
static_assert(NUM_PIXELS == ARRAY_SIZE2(angles), "");

#if IS_FIBONACCI // drawSpiralLine() uses angles[] and physicalToFibonacci[]
void drawSpiralLine(uint8_t angle, int step, CRGB color)
{
  int startIndex = 0;
  int smallestAngleDifference = 255;

  // find the outermost led closest to the desired angle
  for (int i = 0; i < NUM_PIXELS; i++) {
    int j = physicalToFibonacci[i];
    if (j < step) continue;
    if (!(j + step >= NUM_PIXELS)) continue; // not outermost
    uint8_t a = angles[i];
    if (a == angle) startIndex = i;
    else if (angle - a > 0 && angle - a < smallestAngleDifference) {
      smallestAngleDifference = angle - a;
      startIndex = i;
    }
  }

  // draw the starting LED
  leds[startIndex] += color;

  // draw to center from outer start
  int f = physicalToFibonacci[startIndex];
  while (f - step >= 0 && f - step < NUM_PIXELS) {
    leds[fibonacciToPhysical[f]] += color;
    f = f - step;
  }
}
#endif

#if HAS_COORDINATE_MAP

// given an angle and radius (and delta for both), set pixels that fall inside that range
void setPixelAR(uint8_t angle, uint8_t dAngle, uint8_t radius, uint8_t dRadius, CRGB color)
{
  uint8_t endRadius   = qadd8(radius, dRadius);
  uint8_t startRadius = qsub8(radius, dRadius);

  for (uint16_t i = 0; i < NUM_PIXELS; i++) {
  // TODO: Change from pre-processor defines to `static const bool` values where possible
    uint8_t ro = radiusProxy[i];
    // only mess with the pixel when it's radius is within the target radius
    if (ro <= endRadius && ro >= startRadius) {
      // Get pixel's angle (unit256)
      uint8_t ao = angles[i];
      // set adiff to abs(ao - angle) ... relies on unsigned underflow resulting in larger value
      uint8_t adiff = min(sub8(ao,angle), sub8(angle, ao));
      // only mess with the pixel when it's angle is within range of target
      if (adiff <= dAngle) {
        leds[i] = color;
      }
    }
  }
}

// given an angle and radius (and delta for both), add color to pixels that fall inside that range
void andPixelAR(uint8_t angle, uint8_t dAngle, uint8_t startRadius, uint8_t endRadius, CRGB color)
{
  for (uint16_t i = 0; i < NUM_PIXELS; i++) {
    uint8_t ro = radiusProxy[i];
    // only mess with the pixel when it's radius is within the target radius
    if (ro <= endRadius && ro >= startRadius) {
      // Get pixel's angle (unit256)
      uint8_t ao = angles[i];
      // set adiff to abs(ao - angle) ... relies on unsigned underflow resulting in larger value
      uint8_t adiff = min(sub8(ao,angle), sub8(angle, ao));
      // only mess with the pixel when it's angle is within range of target
      if (adiff <= dAngle) {
        leds[i] += color;
      }
    }
  }
}

// given an angle and radius (and delta for both), set pixels that fall inside that range,
// fading the color from full-color at center, to off (black) at the outer edges.
void antialiasPixelAR(uint8_t angle, uint8_t dAngle, uint8_t startRadius, uint8_t endRadius, CRGB color, CRGB leds[], int _NUM_PIXELS)
{
  // NOTE:
  // An earlier version of this routine had significant bugs.
  // Do NOT use the version which does qsub8(max(...), min()),
  // as it does not handle angle overflow well.
  // This version does it properly:
  // 1. subtract both ways
  // 2. note that unsigned underlow will make the negative result really large instead
  // 3. take smaller value
  // This is the absolute offset from the target angle
  for (uint16_t i = 0; i < _NUM_PIXELS; i++) {
    uint8_t ro = radiusProxy[i];
    // only mess with the pixel when it's radius is within the target radius
    if (ro <= endRadius && ro >= startRadius) {
      // Get pixel's angle (unit256)
      uint8_t ao = angles[i];
      // set adiff to abs(ao - angle) ... relies on unsigned underflow resulting in larger value
      uint8_t adiff = min(sub8(ao,angle), sub8(angle, ao));
      // only mess with the pixel when it's angle is within range of target
      if (adiff <= dAngle) {
        // map the intensity of the color so it fades to black at edge of allowed angle
        uint8_t fade = map(adiff, 0, dAngle, 0, 255);
        CRGB faded = color;
        // fade the target color based on how far the angle was from the target
        faded.fadeToBlackBy(fade);
        // add the faded color (as an overlay) to existing colors
        leds[i] += faded;
      }
    }
  }
}

// TODO - anglePalette() from Fib32 sets `hues = 256 / NUM_PIXELS' ... which is ZERO(!)
//        The other similar functions are hard-coded to `hues = 1` even on Fib32.
//        Likely a bug in Fib32 branch for this one function?
//        Check if other branches did similar, or set to hard-coded value of 1?
void anglePalette() {
  uint16_t hues = 1;

  for (uint16_t i = 0; i < NUM_PIXELS; i++) {
    uint16_t x = angles[i];

    leds[i] = ColorFromPalette(palettes[currentPaletteIndex], beat8(speed) - (x * hues));
  }
}

void radiusPalette() {
  uint16_t hues = 1;

  for (uint16_t i = 0; i < NUM_PIXELS; i++) {

    unsigned tmp = ((unsigned)(radiusProxy[i]));
#if ((NUM_PIXELS & (NUM_PIXELS-1)) == 0) // Power-of-two, so no need to check
    uint8_t r = tmp;
#else
    uint8_t r = tmp > 255 ? 255 : tmp;
#endif
    leds[i] = ColorFromPalette(palettes[currentPaletteIndex], beat8(speed) - (r * hues));
  }
}

void xPalette() {
  uint16_t hues = 1;

  for (uint16_t i = 0; i < NUM_PIXELS; i++) {
    uint16_t x = coordsX[i];

    leds[i] = ColorFromPalette(palettes[currentPaletteIndex], beat8(speed) - (x * hues));
  }
}

void yPalette() {
  uint16_t hues = 1;

  for (uint16_t i = 0; i < NUM_PIXELS; i++) {
    uint16_t y = coordsY[i];

    leds[i] = ColorFromPalette(palettes[currentPaletteIndex], beat8(speed) - (y * hues));
  }
}

void xyPalette() {
  uint16_t hues = 1;

  for (uint16_t i = 0; i < NUM_PIXELS; i++) {
    uint16_t x = coordsX[i];
    uint16_t y = coordsY[i];

    leds[i] = ColorFromPalette(palettes[currentPaletteIndex], beat8(speed) - ((x + y) * hues));
  }
}

void angleGradientPalette() {
  uint16_t hues = 1;

  for (uint16_t i = 0; i < NUM_PIXELS; i++) {
    uint16_t x = angles[i];

    leds[i] = ColorFromPalette(gCurrentPalette, beat8(speed) - (x * hues));
  }
}

void radiusGradientPalette() {
  uint16_t hues = 1;

  for (uint16_t i = 0; i < NUM_PIXELS; i++) {
    unsigned tmp = (unsigned)radiusProxy[i];
#if ((NUM_PIXELS & (NUM_PIXELS-1)) == 0) // Power-of-two, so no need to check
    uint8_t r = tmp;
#else
    uint8_t r = tmp > 255 ? 255 : tmp;
#endif

    leds[i] = ColorFromPalette(gCurrentPalette, beat8(speed) - (r * hues));
  }
}

void xGradientPalette() {
  uint16_t hues = 1;

  for (uint16_t i = 0; i < NUM_PIXELS; i++) {
    uint16_t x = coordsX[i];

    leds[i] = ColorFromPalette(gCurrentPalette, beat8(speed) - (x * hues));
  }
}

void yGradientPalette() {
  uint16_t hues = 1;

  for (uint16_t i = 0; i < NUM_PIXELS; i++) {
    uint16_t y = coordsY[i];

    leds[i] = ColorFromPalette(gCurrentPalette, beat8(speed) - (y * hues));
  }
}

void xyGradientPalette() {
  uint16_t hues = 1;

  for (uint16_t i = 0; i < NUM_PIXELS; i++) {
    uint16_t x = coordsX[i];
    uint16_t y = coordsY[i];

    leds[i] = ColorFromPalette(gCurrentPalette, beat8(speed) - ((x + y) * hues));
  }
}

void radarSweepPalette() {
  fadeToBlackBy(leds, NUM_PIXELS, 64);

  uint8_t a = beat8(speed);
  uint8_t b = beat88(1);

  for (uint16_t i = 0; i < NUM_PIXELS; i++) {
    uint8_t angle = angles[i];

    if(abs(angle - a) < 3) {
      leds[i] = ColorFromPalette(palettes[currentPaletteIndex], beat8(speed));
    }
    if(abs(angle - b) < 3) {
      leds[i] = ColorFromPalette(palettes[currentPaletteIndex], beat8(speed) + 85);
    }
  }
}

void drawAnalogClock() {
  const uint8_t hourRadius = 128;   // 128 of 256 radius "units" ==> 1/2
  const uint8_t minuteRadius = 192; // 192 of 256 radius "units" ==> 3/4
  const uint8_t secondRadius = 255; // 255 of 256 radius "units" ==> 1/1

  const uint8_t hourHandWidth   = 8; // angle @ unit256 ~= 11.25000 degrees
  const uint8_t minuteHandWidth = 7; // angle @ unit256 ~=  9.84375 degrees
  const uint8_t secondHandWidth = 6; // angle @ unit256 ~=  8.43750 degrees

  const float degreesPerSecond = 256.0 / 60.0;
  const float degreesPerMinute = 256.0 / 60.0;
  const float degreesPerHour   = 256.0 / 12.0;

  static uint8_t hourAngle   = 0;
  static uint8_t minuteAngle = 0;
  static uint8_t secondAngle = 0;

  EVERY_N_MILLIS(100) {
    float second = timeClient.getSeconds();
    float minute = timeClient.getMinutes() + (second / 60.0);
    float hour   = timeClient.getHours()   + (minute / 60.0);

    hourAngle   = 64u - hour   * degreesPerHour;
    minuteAngle = 64u - minute * degreesPerMinute;
    secondAngle = 64u - second * degreesPerSecond;
  }

  // although can update angles once every 100ms, have to perform fade & overlay with each cycle
  fadeToBlackBy(leds, NUM_PIXELS, clockBackgroundFade);
  antialiasPixelAR(secondAngle, secondHandWidth, 0, secondRadius, CRGB::Blue );
  antialiasPixelAR(minuteAngle, minuteHandWidth, 0, minuteRadius, CRGB::Green);
  antialiasPixelAR(hourAngle, hourHandWidth, 0, hourRadius, CRGB::Red);
  // leds[0] = CRGB::Red; // need to rethink, physical LED 0 is not always in the center...
}

#endif

// TODO: `drawSpiralAnalogClock***()` -- config to disable the seconds hand?

#if IS_FIBONACCI // drawSpiralAnalogClock*() calls drawSpiralLine(), which requires fibonacci

void drawSpiralAnalogClock(uint8_t step_h, uint8_t step_m, uint8_t step_s) {
  static uint8_t hourAngle   = 0;
  static uint8_t minuteAngle = 0;
  static uint8_t secondAngle = 0;

  const float degreesPerSecond = 256.0 / 60.0;
  const float degreesPerMinute = 256.0 / 60.0;
  const float degreesPerHour   = 256.0 / 12.0;

  EVERY_N_MILLIS(100) {
    float second = timeClient.getSeconds();
    float minute = timeClient.getMinutes() + (second / 60.0);
    float hour   = timeClient.getHours()   + (minute / 60.0);

    hourAngle   = 64u - hour   * degreesPerHour;
    minuteAngle = 64u - minute * degreesPerMinute;
    secondAngle = 64u - second * degreesPerSecond;
  }

  drawSpiralLine(secondAngle, step_s, CRGB::Blue );
  drawSpiralLine(minuteAngle, step_m, CRGB::Green);
  drawSpiralLine(hourAngle,   step_h, CRGB::Red  );
}
void drawSpiralAnalogClock(uint8_t step) {
  drawSpiralAnalogClock(step, step, step);
}
void drawSpiralAnalogClock13() {
  fadeToBlackBy(leds, NUM_PIXELS, clockBackgroundFade);
  drawSpiralAnalogClock(13);
}
void drawSpiralAnalogClock21() {
  fadeToBlackBy(leds, NUM_PIXELS, clockBackgroundFade);
  drawSpiralAnalogClock(21);
}
void drawSpiralAnalogClock34() {
  fadeToBlackBy(leds, NUM_PIXELS, clockBackgroundFade);
  drawSpiralAnalogClock(34);
}
void drawSpiralAnalogClock55() {
  fadeToBlackBy(leds, NUM_PIXELS, clockBackgroundFade);
  drawSpiralAnalogClock(55);
}
void drawSpiralAnalogClock89() {
  fadeToBlackBy(leds, NUM_PIXELS, clockBackgroundFade);
  drawSpiralAnalogClock(89);
}
void drawSpiralAnalogClock21and34() {
  fadeToBlackBy(leds, NUM_PIXELS, clockBackgroundFade);
  drawSpiralAnalogClock(21);
  drawSpiralAnalogClock(34);
}
void drawSpiralAnalogClock13_21_and_34() {
  fadeToBlackBy(leds, NUM_PIXELS, clockBackgroundFade);
  drawSpiralAnalogClock(34, 21, 13);
}
void drawSpiralAnalogClock34_21_and_13() {
  fadeToBlackBy(leds, NUM_PIXELS, clockBackgroundFade);
  drawSpiralAnalogClock(13, 21, 34);
}
#endif

#endif // IS_FIBONACCI || HAS_COORDINATE_MAP
